#include <Arduino.h>

// Talkie library
// Copyright 2011 Peter Knight
// This code is released under GPLv2 license.
//
// Welcome to the Talkie library examples.
//
// Talkie is a speech synthesiser that works from a fixed vocabulary.
//
// There are hundreds of words in the 'Vocabulary' examples.
//
// Sound is output on digital pin 3. It can drive headphones directly, or add a simple audio amplifier to drive a loudspeaker.
//

#include <Talkie.h>

Talkie voice;

const uint8_t spDANGER[] PROGMEM = {0x2D, 0xBF, 0x21, 0x92, 0x59, 0xB4, 0x9F, 0xA2, 0x87, 0x10, 0x8E, 0xDC, 0x72,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 0xFF, 0x03};
const uint8_t spMOTOR[]  PROGMEM = {0x66, 0xAA, 0x8C, 0x69, 0x53, 0x92, 0xC4, 0x2D, 0x2F, 0x6B, 0x2A, 0x74, 0xDA,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 0xFD, 0x7F};
const uint8_t spFIRE[]   PROGMEM = {0x04, 0x18, 0xCE, 0x4D, 0x02, 0x1A, 0xD0, 0x80, 0x04, 0x46, 0x91, 0x55, 0x57,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 0xFF, 0x3F};
const uint8_t spON[]     PROGMEM = {0x65, 0x4A, 0xEA, 0x3A, 0x5C, 0xB2, 0xCE, 0x6E, 0x57, 0xA7, 0x48, 0xE6, 0xD2,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 0xFE, 0x1F};
const uint8_t spRED[]    PROGMEM = {0x6A, 0xB5, 0xD9, 0x25, 0x4A, 0xE5, 0xDB, 0xC5, 0x4F, 0x6D, 0x88, 0x95, 0x2D,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 0xFF, 0x07};
const uint8_t spIS[]     PROGMEM = {0xAD, 0xED, 0xD5, 0x58, 0xA4, 0x9E, 0xCE, 0x76, 0xF5, 0xDD, 0xAB, 0x29, 0xF5,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 0xF0, 0xFF};
const uint8_t spALERT[]  PROGMEM = {0xA5, 0xCF, 0xC6, 0xAB, 0x55, 0x5B, 0xAF, 0x39, 0xDA, 0xC9, 0x54, 0xDD, 0xBC,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 0xFF, 0x0F};

const uint8_t *spSpeak[] = {spDANGER, spDANGER, spRED, spALERT, spMOTOR, spIS, spON, spFIRE  };
#define SP_MAX (sizeof( spSpeak ) / sizeof( uint8_t*))
uint8_t iidx = 0;

void setup() {
  Serial.begin(9600);
  pinMode(5, OUTPUT);
  digitalWrite(5, 1);//Enable Amplified.
  while (!Serial && 5000 > millis());
  Serial.println("Setting up");
  //analogReference(INTERNAL);  // drop volume level
}

uint32_t  busyloops = 0;
void loop() {

  if ( !voice.active() ) {
    if (iidx < SP_MAX ) {
      if ( iidx % 2 )
        voice.sayQ(spSpeak[iidx]);
      else
        voice.say(spSpeak[iidx]);
      Serial.print(">>");
      Serial.print("busyloops  ");
      Serial.println(busyloops);
      busyloops = 0;
      Serial.print(">>");
      Serial.println(iidx);

      iidx++;
    }
    else iidx = 0;  // Repeat the Danger Warning over ... Repeat
  }
  else busyloops++;
}
