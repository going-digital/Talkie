// Talkie library
// Copyright 2011 Peter Knight
// This code is released under GPLv2 license.
//
// The following phrases are derived from those built into the
// Acorn Computers Speech Synthesiser add-on from 1983.
//
// A male voice with an RP English accent, voiced by Kenneth Kendall.
//
// Due to the large vocabulary, this file takes up 16Kbytes of flash.
// To save space, just copy and paste the words you need.

#define ACORN
#include <Talkie.h>

#ifdef ACORN
const uint8_t spPAUSE1[]    PROGMEM = {0x08, 0x14, 0xC1, 0xDD, 0x45, 0x64, 0x03, 0x00, 0xFC, 0x4A, 0x56, 0x26, 0x3A, 0x06, 0x0A};
const uint8_t spPAUSE2[]    PROGMEM = {0x08, 0x14, 0xC1, 0xDD, 0x45, 0x64, 0x03, 0x00, 0x00, 0x00, 0xC0, 0xFF, 0x4A, 0x46, 0x51, 0x39, 0x79, 0x15, 0x0A};
const uint8_t spTONE1[]     PROGMEM = {0x8D, 0xF2, 0xDE, 0xDD, 0xDD, 0x93, 0x74, 0xAA, 0x53, 0x9D, 0xEA, 0x54, 0xA7,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 0x15, 0x0A};
const uint8_t spTONE2[]     PROGMEM = {0x4D, 0xF1, 0xDE, 0xDD, 0xDD, 0x93, 0x74, 0xA5, 0x2B, 0x5D, 0xE9, 0x4A, 0x57,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 0x11, 0x5A};
const uint8_t spTHREE[]     PROGMEM = {0x08, 0xA8, 0xC2, 0x8C, 0x02, 0x04, 0x68, 0x2A, 0xDC, 0xF9, 0x51, 0x5B, 0x96,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 0x5A, 0x66};
const uint8_t spEIGH_[]     PROGMEM = {0x23, 0x1E, 0xC5, 0x58, 0x33, 0xA7, 0x9E, 0xA0, 0x6A, 0xF1, 0xAD, 0x9E, 0xB2,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 0xFF, 0x4E};
const uint8_t spNINE_[]     PROGMEM = {0xA1, 0x4A, 0x4C, 0xF4, 0x31, 0xDD, 0x85, 0x32, 0x71, 0xB6, 0xC7, 0x74, 0x57,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 0xFF, 0x41};
const uint8_t spACORN[]     PROGMEM = {0x23, 0x9B, 0x35, 0x85, 0xD3, 0x96, 0x9C, 0x64, 0xD6, 0x12, 0x0A, 0x5F, 0x7C,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 0x31, 0x41};
const uint8_t spCASSETTE[]  PROGMEM = {0x06, 0x68, 0x86, 0x65, 0x84, 0x55, 0x8B, 0x74, 0xB9, 0xAD, 0x13, 0xB5, 0xEC,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 0x09, 0x61};
const uint8_t spCOMPUTER[]  PROGMEM = {0x06, 0x28, 0x29, 0x68, 0x44, 0x29, 0xAA, 0xA6, 0xD6, 0xEC, 0x15, 0xE7, 0x9C,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 0x79, 0x61};
const uint8_t spFILE[]      PROGMEM = {0x08, 0xE8, 0xD2, 0x95, 0x00, 0x4D, 0xA7, 0x09, 0xA0, 0xC8, 0xF0, 0xE6, 0xE5,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 0x49, 0x31};
const uint8_t spFROM[]      PROGMEM = {0x08, 0xE8, 0xDA, 0x84, 0x02, 0x0A, 0x68, 0x26, 0x54, 0x03, 0xAE, 0x88, 0x83,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 0xFF, 0x71};
const uint8_t spILLEGAL[]   PROGMEM = {0x25, 0x19, 0x4C, 0xA9, 0x6F, 0x42, 0xF7, 0x2C, 0x67, 0x21, 0x5F, 0x20, 0x38,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 0x39, 0x49};
const uint8_t spIS[]        PROGMEM = {0xC9, 0x5F, 0x3E, 0x90, 0xB2, 0x17, 0xDF, 0xE0, 0x04, 0xDB, 0x04, 0x72, 0xF5,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 0xFA, 0x29};
const uint8_t spNEGATIVE[]  PROGMEM = {0x26, 0x2E, 0x4C, 0x24, 0xCC, 0x13, 0xC5, 0x32, 0x14, 0x49, 0xD0, 0x9C, 0xA4,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 0x51, 0x39};
const uint8_t spNO[]        PROGMEM = {0xAC, 0xEF, 0xCC, 0xD9, 0x25, 0x6C, 0xBB, 0xB6, 0x50, 0xD1, 0xC7, 0x74, 0x17,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 0x79, 0x39};
const uint8_t spNUMBER[]    PROGMEM = {0xA6, 0x0A, 0x42, 0x72, 0xB9, 0xDC, 0x84, 0x32, 0x0A, 0x89, 0xA3, 0x72, 0x13,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 0xFA, 0x79};
const uint8_t spPARAMETER[] PROGMEM = {0x04, 0xD0, 0xA2, 0x3D, 0xA5, 0xC5, 0xA7, 0x9B, 0x6B, 0xCD, 0x91, 0xE6, 0x21,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 0x51, 0x05};
const uint8_t spPROGRAMME[] PROGMEM = {0x0C, 0x48, 0x2E, 0x95, 0x03, 0x2E, 0x0A, 0x8D, 0x3D, 0xDA, 0x13, 0xD5, 0x68,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 0xF2, 0x45};
const uint8_t spTHIS[]      PROGMEM = {0xAA, 0xF2, 0xD2, 0x6C, 0xA4, 0x2A, 0xAA, 0xCA, 0x4B, 0xB5, 0xB6, 0x6C, 0x18,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 0x49, 0x15};
const uint8_t spYOUR[]      PROGMEM = {0xA1, 0x69, 0x86, 0xD1, 0xA7, 0x2B, 0xE5, 0x3A, 0x55, 0x2D, 0x08, 0xDA, 0xC4,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 0xFF, 0x2D};
const uint8_t * indexArray [] {spTHIS, spIS, spNO, spNEGATIVE, spPARAMETER, spPROGRAMME, spNUMBER, spILLEGAL, spCASSETTE, spPAUSE1, spPAUSE2};
#endif

Talkie voice;

#define qBlink() (digitalWriteFast(LED_BUILTIN, !digitalReadFast(LED_BUILTIN) ))  // This toggles the Teensy 3.2 Builtin LED pin 13
void setup() {
  while (!Serial && 5000 > millis());
  Serial.println("\nSetting up");
  pinMode(LED_BUILTIN, OUTPUT);
  qBlink();
  pinMode(5, OUTPUT);
  digitalWrite(5, HIGH);//Enable Amplified PROP shield
  delay(10);
  voice.say( spACORN ); // This orignal function when used blocks until all queued sounds have played
}

int wordarray[] {0, 1, 2, 3, 6, 9, 0, 1, 2, 3, 4, 9, 7, 8, 10, 7, 8, 10};
int wordarraysize = sizeof (wordarray) / 4;
void loop() {
  arrayInterface (wordarray, wordarraysize);
  uint8_t xx = voice.active(), yy;
  while ( (yy = voice.active()) > 15 ) {
    if ( xx != yy ) {
      qBlink();
      xx = yy;
      Serial.print( "." );
    }
    delay (5);
  }
}
uint8_t aI_cnt = 0;
bool waitAcorn = true;
void arrayInterface (int * wordArray, int wordArraySize) {
  Serial.print( "Array Adding: Active=" );
  Serial.print( voice.active() );
  if ( 2 < ++aI_cnt ) {
    if ( waitAcorn ) voice.say( spACORN ); // This orignal function when used blocks until all queued sounds have played
    else voice.sayQ( 0 ); // Empty queue to test code
    waitAcorn = !waitAcorn;
    aI_cnt = 0;
    Serial.print( " EMPTY QUEUE: " );
    while ( voice.active() ) Serial.print( "^" ); // Allow silence to come, a PAUSE is played to turn off synthesis
    Serial.print( " :: Active=" );
    Serial.println( voice.active() );
    delay(1000);  // Sweet Silence!
  }
  for (uint8_t i = 0; i < wordArraySize; i++) {
    qBlink();
    Serial.print( " Q=" );
    Serial.print( voice.sayQ (indexArray[wordArray[i]]) );
  }
  Serial.print( ":: Array Added: Active=" );
  Serial.println( voice.active() );
}

